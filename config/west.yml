## config/west.yml
```yaml
manifest:
  remotes:
    - name: zmkfirmware
      url-base: https://github.com/zmkfirmware
    - name: caksoylar
      url-base: https://github.com/caksoylar
    - name: paoloantinori
      url-base: https://github.com/paoloantinori
    - name: urob
      url-base: https://github.com/urob
  projects:
    - name: zmk
      remote: paoloantinori
      revision: zen-v1+v2-rebased
      import: app/west.yml
    - name: zmk-rgbled-widget
      remote: caksoylar
      revision: main
    - name: zmk-smart-toggle
      remote: caksoylar
      revision: main
    - name: zmk-auto-layer
      remote: urob
      revision: main
    - name: zmk-leader-key
      remote: urob
      revision: main
    - name: zmk-helpers
      remote: urob
      revision: main
  self:
    path: config
# manifest:
#   remotes:
#     - name: morou
#       url-base: https://github.com/morou
#   projects:
#     - name: zmk
#       remote: morou
#       revision: zen-v1+v2-debug
#       import: app/west.yml
#   self:
#     path: config
```
